## main/Kconfig.projbuild
```kconfig
menu "BLUETTI NUT Bridge"

    comment "These are first-boot DEFAULTS only. The captive-portal setup"
    comment "writes the real values to NVS on first run."

    config WIFI_SSID
        string "Default Wi-Fi SSID"
        default "myssid"
        help
            Leave as "myssid" to force the setup portal on first boot.

    config WIFI_PASSWORD
        string "Default Wi-Fi password"
        default "mypassword"

    config RESET_HOLD_GPIO
        int "Config-wipe button GPIO"
        default 0
        help
            Hold this pin low (to GND) through reset for RESET_HOLD_MS to
            erase the stored config and return to setup mode. GPIO0 is the
            BOOT button on most dev boards.

    config RESET_HOLD_MS
        int "Config-wipe hold time (ms)"
        default 3000

    config ENABLE_WEB_OTA
        bool "Firmware update from the admin web page"
        default y
        help
            Adds a firmware-upload box to the Maintenance tab. The device
            writes the uploaded .bin to the spare OTA slot and reboots, with
            bootloader rollback if it won't come up. There is no auth on the
            web UI beyond a typed confirmation, so disable this if the device
            might sit on an untrusted network.

    config BLUETTI_BLE_ADDRESS
        string "BLUETTI BLE address"
        default ""
        help
            MAC address of the BLUETTI unit, e.g. AA:BB:CC:DD:EE:FF.
            Leave empty to connect by advertised name instead.

    config OTA_GITHUB_OWNER
        string "GitHub owner for firmware updates"
        default "thatguy-za"
        help
            Update checks read this repository's releases. Point both this
            and OTA_GITHUB_REPO at your own fork if you publish your own
            builds — the device installs whatever that repo publishes.

    config OTA_GITHUB_REPO
        string "GitHub repository for firmware updates"
        default "esp32-nut-bluetti"
        help
            Also the asset name stem: the update downloads
            <repo>-<version>.bin from the matching release tag.

    config BLUETTI_POLL_INTERVAL_MS
        int "BLUETTI poll interval (ms)"
        default 5000

    config BLUETTI_BLE_TRACE
        bool "Trace the BLUETTI BLE handshake (verbose, logs derived keys)"
        default n
        help
            Hex-dumps every handshake stage at INFO level — our/device public
            keys, the shared secret, IV, session key, auth token, and every
            decoded inner packet. Use this to bring the BLE link up on new
            hardware, then turn it back off (it prints key material).

    config NUT_UPS_NAME
        string "NUT UPS name"
        default "bluetti"
        help
            Name NUT clients use: upsc <name>@<esp32-ip>.

    config NUT_TCP_PORT
        int "NUT TCP listen port"
        default 3493

    config NUT_AC_RATING_W
        int "Default continuous AC output rating (W)"
        default 200
        help
            Used as the 100% reference for ups.load and reported as
            ups.realpower.nominal. Varies by model (200 W on an Elite 10);
            set your unit's figure in the admin page.

    config NUT_RUNTIME_LOW_S
        int "Default battery.runtime.low (seconds)"
        default 300
        help
            Runtime remaining at which upsmon should treat the UPS as low.

    config NUT_BATTERY_LOW_PCT
        int "battery.charge.low threshold (%)"
        default 20

    config STATUS_LED_GPIO
        int "Default status LED GPIO (addressable WS2812; -1 to disable)"
        default 48
        help
            The pin the status LED starts on. It can be changed later from
            the Maintenance page without a rebuild, so this only needs to
            be right often enough to be a useful default. The single
            addressable LED on most ESP32-S3 dev boards is on GPIO 48; some
            use 38 or 21. Set to -1 for a board with no addressable LED, or
            one wired to a plain single-colour LED, which this cannot drive.

endmenu
```
